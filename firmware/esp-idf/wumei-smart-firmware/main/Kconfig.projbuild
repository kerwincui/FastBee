## firmware/esp-idf/wumei-smart-firmware/main/Kconfig.projbuild
```kconfig
menu "Configuration"

    config MAX_CPU_FREQ_MHZ
        int "Maximum CPU frequency"
        default 80
        help
            Maximum CPU frequency 80/160/240.

    config MIN_CPU_FREQ_MHZ
        int "Minimum CPU frequency"
        default 10
        help
            Minimum CPU frequency 10/13/20/26/40.
            
    choice SNTP_TIME_SYNC_METHOD
        prompt "Time synchronization method"
        default SNTP_TIME_SYNC_METHOD_IMMED
        help
            Time synchronization method.

        config SNTP_TIME_SYNC_METHOD_IMMED
            bool "update time immediately when received"
        config SNTP_TIME_SYNC_METHOD_SMOOTH
            bool "update time with smooth method (adjtime)"
        config SNTP_TIME_SYNC_METHOD_CUSTOM
            bool "custom implementation"
    endchoice


    config FIRMWARE_UPG_URL
        string "Firmware Upgrade URL"
        default "http://wumei.live/prod-api/common/download/firmware?fileName=wumei-open.bin"
        help
            URL of server which hosts the firmware image.

    config SKIP_COMMON_NAME_CHECK
        bool "Skip server certificate CN fieldcheck"
        default n
        help
            This allows you to skip the validation of OTA server certificate CN field.

    config SKIP_VERSION_CHECK
        bool "Skip firmware version check"
        default y
        help
            This allows you to skip the firmware version check.

    config GPIO_DIAGNOSTIC
        int "Number of the GPIO input for diagnostic"
        range 0 39
        default 35
        help
            Used to demonstrate how a rollback works.
            The selected GPIO will be configured as an input with internal pull-up enabled.
            To trigger a rollback, this GPIO must be pulled low while the message
            `Diagnostics (5 sec)...` which will be on first boot.
            If GPIO is not pulled low then the operable of the app will be confirmed.

    config OTA_RECV_TIMEOUT
        int "OTA Receive Timeout"
        default 5000
        help
            Maximum time for reception
    
endmenu
```

## sdk/ESP-IDF/esp_fastbee_aliyun/components/factory_restore/Kconfig.projbuild
```kconfig
menu "[Aliyun]Factory restore"

    config FACTORY_QUICK_REBOOT_TIMEOUT
        int "Quick reboot timeout, unit second"
        default 6
        help
            Timeout for exiting quick reboot timer, users should reboot device before this timeout.

    config FACTORY_QUICK_REBOOT_MAX_TIMES
        int "Quick reboot times max record"
        default 5
        help
            If quick reboot times reach this max value, device will do factory restore.

endmenu
```

## sdk/ESP-IDF/esp_fastbee_aliyun/esp-aliyun/Kconfig
```kconfig
menu "iotkit embedded"

    menu "Aliyun linkkit device version"

        config LINKKIT_FIRMWARE_VERSION
            string "Device version"
            default "0.0.1"
            help
                aliyun linkkit device version
    endmenu

    menu "Aliyun linkkit awss config"
        config AWSS_ENCRYPT_TYPE
            int "Get the security level of the `smartconfig` service"
            range 1 5
            default 3
            help
                Get the security level of the `smartconfig` service

        config AWSS_CONN_ENCRYPT_TYPE
            int "Get Security level for wifi configuration with connection.Used for AP solution of router and App"
            range 3 5
            default 4
            help
                Get Security level for wifi configuration with connection.Used for AP solution of router and App

        config AWSS_TIMEOUT_INTERVAL_MS
            int "Get the timeout period of the distribution service (`AWSS`), in milliseconds"
            range 0 1800000
            default 180000
            help
                Get the timeout period of the distribution service (`AWSS`), in milliseconds

        config AWSS_CHANNELSCAN_INTERVAL_MS
            int "Get the length of time scanned on each channel (`channel`), in milliseconds"
            range 0 1000
            default 200
            help
                Get the length of time scanned on each channel (`channel`), in milliseconds
    endmenu

    menu "Aliyun linkkit network config"
        config SUPPORT_TCP
            bool "Enable tcp connection"
            default n
            help
                Select this option to enable tcp connection

        config TCP_ESTABLISH_TIMEOUT_MS
            int "Device tcp connection timeout wait time milliseconds"
            range 0 100000
            default 10000
            help
                Device tcp connection timeout wait time milliseconds

        config TLS_ESTABLISH_TIMEOUT_MS
            int "Device tls connection timeout wait time milliseconds"
            range 0 100000
            default 10000
            help
                Device tls connection timeout wait time milliseconds
    endmenu

    menu "Aliyun linkkit device model config"
        config DEVICE_MODEL_GATEWAY
            bool "Enable device model gateway"
            default n
            help
                Select this option to enable device model gateway
    endmenu

    menu "Aliyun linkkit local control"
        config DEVICE_ALCS_ENABLE
            bool "Enable device local control"
            default n
            help
                Select this option to enable device local control
    endmenu

    menu "Aliyun linkkit security OTA"
        config SUPPORT_SECURITY_OTA
            bool "Enable Security OTA"
            default n
            help
                Select this option to enable security ota
    endmenu

    menu "Aliyun linkkit dynamic register"
        config DYNAMIC_REGISTER
            bool "Enable dynamic register"
            default y
            help
                Select this option to enable dynamic register
    endmenu

    menu "Aliyun linkkit mqtt config"
        config MQTT_DIRECT
            bool "MQTT DIRECT"
            default y
            help
                Directly connect MQTT server without perform HTTP authenticate to another HTTP server ahead

                Switching to "y" leads to connect MQTT server directly and MQTT_DIRECT included into CFLAGS
                Switching to "n" leads to legacy authenticate mode: connnect HTTP server first, then connect MQTT server afterwards
    endmenu

config HAL_SEM_MAX_COUNT
    int "The maximum count value that can be reached of the semaphore"
    default 255
    range 0 255
    help
        The recommended value of maximum count of the semaphore is 255

config HAL_SEM_INIT_COUNT
    int "The count value assigned to the semaphore when it is created"
    default 0
    range 0 10
    help
        The recommended value of count of the semaphore is 0
config HAL_TLS_HANDSHAKE_TIMEOUT
    int "TLS Handsake Timeout"
    default 180
    range 0 65535
    help
        Default TLS handshake timeout to host in seconds
config HAL_USE_CUSTOMER_AP_SSID
    bool "Enable use customer softap SSID"
    default n
    help
        Select this option to enable use customer softap SSID
config AP_SSID_KEY
    string "AP SSID KV Key value"
    default "apssid"
    help
        The KV key value which store AP SSID

config USE_SOFTAP_CONFIG
    bool "Use softap config in smart light example"
    default n
    help
        smart light example will use softap config when enable this option. Otherwise use smartconfig.

endmenu
```

## sdk/ESP-IDF/esp_fastbee_aliyun/main/Kconfig.projbuild
```kconfig
menu "WIFI Configuration"

    config ESP_WIFI_SSID
        string "WiFi SSID"
        default "myssid"
        help
            SSID (network name) for the example to connect to.

    config ESP_WIFI_PASSWORD
        string "WiFi Password"
        default "mypassword"
        help
            WiFi password (WPA or WPA2) for the example to use.

endmenu

menu "Platform Configuration"
    choice ESP_MQTT_PLATFORM
        prompt "The platform connected by mqtt"
        default ESP_MQTT_PLATFORM_FASTBEE
        help
            The platform connected by mqtt.
        config ESP_MQTT_PLATFORM_ALIYUN
            bool "aliyun"
        config ESP_MQTT_PLATFORM_FASTBEE
            bool "fastbee"
    endchoice

    config ESP_MQTT_PLATFORM_FASTBEE_URL
        string "MQTT URL"
        default "fastbee.cn:1883"
        help
            MQTT URL.

    config ESP_MQTT_PLATFORM_FASTBEE_USERNAME
        string "MQTT Username"
        default "FastBee"
        help
            MQTT Username.

    config ESP_MQTT_PLATFORM_FASTBEE_PASSWORD
        string "MQTT Password"
        default "P63653937TRQ8F27"
        help
            MQTT Password.   

    config ESP_MQTT_PLATFORM_FASTBEE_USERID
        string "Platform user ID"
        default "1"
        help
            Platform user ID.

    config ESP_MQTT_PLATFORM_FASTBEE_PRODICTID
        string "Platform product ID"
        default "588"
        help
            Platform product ID.    

    config ESP_MQTT_PLATFORM_FASTBEE_DEVICESN
        string "Platform device serial number"
        default "D1FJTWOT3HIB"
        help
            Platform device serial number        

endmenu
```

## sdk/ESP-IDF/esp_fastbee_aliyun/sdkconfig.defaults.esp32s2
```kconfig
CONFIG_ESPTOOLPY_FLASHSIZE_4MB=y
CONFIG_PARTITION_TABLE_CUSTOM=y
CONFIG_PARTITION_TABLE_CUSTOM_FILENAME="partitions_esp32s2.csv"
```
